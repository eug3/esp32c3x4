## c3x4_main_control/examples/minimal_nimble/sdkconfig.defaults
```kconfig
# Minimal defaults to enable BT + NimBLE for ESP32-C3
CONFIG_BT_ENABLED=y
CONFIG_BT_NIMBLE_ENABLED=y
CONFIG_BT_CONTROLLER_ENABLED=y
CONFIG_BT_BLUEDROID_ENABLED=n
CONFIG_BT_NIMBLE_MEM_ALLOC_MODE_INTERNAL=y
CONFIG_BT_NIMBLE_LEGACY_VHCI_ENABLE=y
CONFIG_BT_CTRL_HCI_MODE_VHCI=y
CONFIG_BT_CTRL_HCI_TL=1
CONFIG_BT_CTRL_MODE_EFF=1
CONFIG_BT_CTRL_PINNED_TO_CORE=0
# Optional: lower NimBLE log level to reduce console noise
CONFIG_BT_NIMBLE_LOG_LEVEL_INFO=y
```

## c3x4_main_control/sdkconfig.defaults
```kconfig
# GUI Paint Configuration for Xteink X4 EPD
# No special configuration needed - using default ESP-IDF settings

# FATFS: enable UTF-8 API encoding so Chinese/long filenames work
CONFIG_FATFS_LFN_STACK=y
CONFIG_FATFS_MAX_LFN=255
CONFIG_FATFS_API_ENCODING_UTF_8=y
CONFIG_FATFS_CODEPAGE_936=y
# Bluetooth Configuration - Enable BLE support for BLE Reader feature
CONFIG_BT_ENABLED=y
CONFIG_BT_NIMBLE_ENABLED=y
CONFIG_BT_NIMBLE_MEM_ALLOC_MODE_INTERNAL=y
CONFIG_BT_NIMBLE_LEGACY_VHCI_ENABLE=y
CONFIG_BT_NIMBLE_ROLE_CENTRAL=y
CONFIG_BT_NIMBLE_ROLE_PERIPHERAL=y
CONFIG_BT_NIMBLE_HOST_TASK_STACK_SIZE=3072

# BLE Controller Memory Optimization for ESP32-C3
CONFIG_BTDM_CTRL_BLE_MAX_CONN=3
CONFIG_BTDM_CTRL_BLE_MAX_CONN_EFF=3
CONFIG_BT_CTRL_BLE_MAX_ACT=6
CONFIG_BT_CTRL_BLE_MAX_ACT_EFF=6

# NimBLE Memory Optimization
CONFIG_BT_NIMBLE_MAX_CONNECTIONS=3
CONFIG_BT_NIMBLE_ACL_BUF_COUNT=24
CONFIG_BT_NIMBLE_ACL_BUF_SIZE=255
CONFIG_BT_NIMBLE_HCI_EVT_BUF_SIZE=70
CONFIG_BT_NIMBLE_HCI_EVT_HI_BUF_COUNT=12
CONFIG_BT_NIMBLE_HCI_EVT_LO_BUF_COUNT=12
CONFIG_BT_NIMBLE_MSYS1_BLOCK_COUNT=50
CONFIG_BT_NIMBLE_MSYS_1_BLOCK_SIZE=256
CONFIG_BT_NIMBLE_MSYS_2_BLOCK_COUNT=6
CONFIG_BT_NIMBLE_MSYS_2_BLOCK_SIZE=320
```
